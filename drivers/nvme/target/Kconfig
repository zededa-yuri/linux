## drivers/nvme/target/Kconfig
```kconfig
config NVME_TARGET
	depends on BLOCK
	tristate

config NVME_TARGET_LOOP
	tristate "NVMe loopback device support"
	depends on BLK_DEV_NVME
	select NVME_TARGET
	help
	  This enabled the NVMe loopback device support, which can be useful
	  to test NVMe host and target side features.

	  If unsure, say N.

config NVME_TARGET_VHOST
	tristate "NVMe vhost support"
	depends on BLK_DEV_NVME
	select NVME_TARGET
	select VHOST
	select VHOST_RING
	help
	  This enabled the NVMe vhost support.

	  If unsure, say N.
```

## drivers/nvme/target/vhost_nvme/Kconfig
```kconfig
config VHOST_NVME
	tristate "VHOST_NVME fabric module"
	depends on TARGET_CORE && CONFIGFS_FS
	default n
	help
	  Say Y here to enable the VHOST_NVME fabric module
```
